## Kconfig
```kconfig
# Kconfig file for package cmw
menuconfig PKG_USING_CMW
    bool "Chen Jianying's public middleware"
    default n

if PKG_USING_CMW

    config PKG_CMW_PATH
        string
        default "/packages/misc/cmw"

    choice
        prompt "Version"
        default PKG_USING_CMW_LATEST_VERSION
        help
            Select the package version

        config PKG_USING_CMW_V100
            bool "v1.0.0"

        config PKG_USING_CMW_LATEST_VERSION
            bool "latest"
    endchoice
          
    config PKG_CMW_VER
       string
       default "v1.0.0"    if PKG_USING_CMW_V100
       default "latest"    if PKG_USING_CMW_LATEST_VERSION

endif
```
